## examples/cekirdek/agac-ici/Kconfig
```kconfig
# SPDX-License-Identifier: GPL-2.0-only
# drivers/misc/ornek/Kconfig: ornek_bilgi sürücüsünün çekirdek ağacına eklenmesi (Bölüm 3)

config ORNEK_BILGI
	tristate "Örnek ağ geçidi bilgi sürücüsü"
	depends on SYSFS
	select FW_LOADER
	help
	  Kitabın örnek sürücüsü. Bir platform aygıtı oluşturur, ürün
	  yazılımı ister ve /sys/module/ornek_bilgi/parameters/ altında
	  parametreler sunar.

	  Modül olarak derlenirse adı ornek_bilgi olur.

config ORNEK_BILGI_AYRINTI
	bool "Ayrıntılı hata ayıklama iletileri (DEBUG)"
	depends on ORNEK_BILGI
	help
	  pr_debug() iletilerini derleme sırasında etkinleştirir. Dynamic
	  debug kullanılıyorsa bu seçeneğe gerek yoktur (Bölüm 8).
```

## examples/u-boot/ornek.its
```
// SPDX-License-Identifier: MIT
/*
 * ornek.its: çekirdek, initramfs ve aygıt ağacını tek bir FIT imajında birleştirir. Bölüm 2.
 * Derleme: mkimage -f ornek.its ornek.itb
 */
/dts-v1/;

/ {
	description = "ÖrnekOS FIT imajı (agecidi)";
	#address-cells = <1>;

	images {
		kernel-1 {
			description = "Linux 6.18 çekirdeği";
			data = /incbin/("Image");
			type = "kernel";
			arch = "arm64";
			os = "linux";
			compression = "none";
			load = <0x40400000>;
			entry = <0x40400000>;
			hash-1 {
				algo = "sha256";
			};
		};
		ramdisk-1 {
			description = "initramfs";
			data = /incbin/("initramfs.cpio.gz");
			type = "ramdisk";
			arch = "arm64";
			os = "linux";
			compression = "none";
			hash-1 {
				algo = "sha256";
			};
		};
		fdt-1 {
			description = "QEMU virt aygıt ağacı";
			data = /incbin/("virt.dtb");
			type = "flat_dt";
			arch = "arm64";
			compression = "none";
			hash-1 {
				algo = "sha256";
			};
		};
	};

	configurations {
		default = "conf-1";
		conf-1 {
			description = "agecidi: çekirdek + initramfs + dtb";
			kernel = "kernel-1";
			ramdisk = "ramdisk-1";
			fdt = "fdt-1";
		};
	};
};
```
